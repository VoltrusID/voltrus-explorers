## firmware/esp32-tester/components/bacnet_device/Kconfig
```kconfig
menu "BACnet Device Config"
    config BACNET_UDP_PORT
        int "UDP Port"
        default 47808
    config BACNET_DEVICE_ID
        int "Device Instance ID"
        default 100
endmenu
```

## firmware/esp32-tester/components/dnp3_outstation/Kconfig
```kconfig
menu "DNP3 Outstation Config"
    config DNP3_TCP_PORT
        int "TCP Port"
        default 20000
    config DNP3_OUTSTATION_ADDR
        int "Outstation Address"
        default 10
endmenu
```

## firmware/esp32-tester/components/enip_server/Kconfig
```kconfig
menu "EtherNet/IP Server Config"
    config ENIP_SERVER_PORT
        int "TCP Port"
        default 44818
endmenu
```

## firmware/esp32-tester/components/modbus_rtu_slave/Kconfig
```kconfig
menu "Modbus RTU Slave Config"
    config MODBUS_RTU_BAUD
        int "UART Baud Rate"
        default 9600
    config MODBUS_RTU_SLAVE_ID
        int "Slave ID"
        default 1
    config MODBUS_RTU_DE_PIN
        int "RS485 DE/RE Pin"
        default 4
    config MODBUS_RTU_TX_PIN
        int "UART TX Pin"
        default 17
    config MODBUS_RTU_RX_PIN
        int "UART RX Pin"
        default 16
endmenu
```

## firmware/esp32-tester/components/modbus_tcp_master/Kconfig
```kconfig
menu "Modbus TCP Master Config"
    config MODBUS_MASTER_SERVER_IP
        string "Target Server IP"
        default "192.168.1.100"
    config MODBUS_MASTER_SERVER_PORT
        int "Target Server Port"
        default 502
    config MODBUS_MASTER_POLL_INTERVAL_MS
        int "Poll Interval (ms)"
        default 2000
endmenu
```

## firmware/esp32-tester/components/modbus_tcp_slave/Kconfig
```kconfig
menu "Modbus TCP Slave Config"
    config MODBUS_SLAVE_PORT
        int "TCP Port"
        default 502
    config MODBUS_SLAVE_ID
        int "Slave ID"
        default 1
    config MODBUS_SLAVE_NUM_REGISTERS
        int "Number of Holding Registers"
        default 100
    config MODBUS_SLAVE_NUM_COILS
        int "Number of Coils"
        default 100
endmenu
```

## firmware/esp32-tester/components/mqtt_client/Kconfig
```kconfig
menu "MQTT Client Config"
    config MQTT_BROKER_URL
        string "Broker URL"
        default "mqtt://broker.hivemq.com:1883"
    config MQTT_PUBLISH_INTERVAL_MS
        int "Publish Interval (ms)"
        default 5000
endmenu
```

## firmware/esp32-tester/components/opcua_server/Kconfig
```kconfig
menu "OPC UA Server Config"
    config OPCUA_SERVER_PORT
        int "TCP Port"
        default 4840
endmenu
```

## firmware/esp32-tester/components/plc_runtime/Kconfig
```kconfig
menu "PLC Runtime Configuration"
    depends on ESP_TESTER_PROTOCOL_PLC_RUNTIME

    config VOLTRUS_PLC_DEFAULT_SCAN_CYCLE_MS
        int "Default scan cycle (ms)"
        default 10
        range 1 60000
        help
            Default PLC scan cycle time in milliseconds.

    config VOLTRUS_PLC_MAX_VARIABLES
        int "Maximum variables"
        default 64
        range 8 256
        help
            Maximum number of PLC variables allocated in the VM.

    config VOLTRUS_PLC_IO_BUFFER_SIZE
        int "I/O buffer size (bytes)"
        default 256
        range 64 1024
        help
            Size of the I/O bridge data buffer in bytes.

    config VOLTRUS_PLC_MDNS_ENABLE
        bool "Enable mDNS advertisement"
        default y
        help
            Broadcast _voltrus-runtime._tcp via mDNS for auto-discovery.

    config VOLTRUS_PLC_OTA_ENABLE
        bool "Enable OTA firmware update"
        default n
        help
            Allow firmware updates via HTTP POST to /api/firmware.
            Requires OTA partition table.
endmenu
```

## firmware/esp32-tester/components/s7_server/Kconfig
```kconfig
menu "S7 Server Config"
    config S7_SERVER_PORT
        int "TCP Port"
        default 102
    config S7_RACK
        int "Rack Number"
        default 0
    config S7_SLOT
        int "Slot Number"
        default 1
endmenu
```

## firmware/esp32-tester/components/serial_bridge/Kconfig
```kconfig
menu "Serial Bridge Config"
    config SERIAL_BRIDGE_BAUD
        int "UART Baud Rate"
        default 9600
    config SERIAL_BRIDGE_TX_PIN
        int "UART TX Pin"
        default 17
    config SERIAL_BRIDGE_RX_PIN
        int "UART RX Pin"
        default 16
    config SERIAL_BRIDGE_DE_PIN
        int "RS485 DE/RE Pin"
        default 4
endmenu
```

## firmware/esp32-tester/main/Kconfig.projbuild
```kconfig
menu "ESP32 Protocol Tester"

choice ESP_TESTER_PROTOCOL
    prompt "Select Protocol"
    default ESP_TESTER_PROTOCOL_MODBUS_SLAVE
    help
        Select which protocol the ESP32 will run.

config ESP_TESTER_PROTOCOL_MODBUS_SLAVE
    bool "Modbus TCP Slave"
config ESP_TESTER_PROTOCOL_MODBUS_MASTER
    bool "Modbus TCP Master"
config ESP_TESTER_PROTOCOL_MODBUS_RTU
    bool "Modbus RTU Slave"
config ESP_TESTER_PROTOCOL_MQTT
    bool "MQTT Client"
config ESP_TESTER_PROTOCOL_S7
    bool "S7 Server"
config ESP_TESTER_PROTOCOL_ENIP
    bool "EtherNet/IP Server"
config ESP_TESTER_PROTOCOL_OPCUA
    bool "OPC UA Server"
config ESP_TESTER_PROTOCOL_BACNET
    bool "BACnet Device"
config ESP_TESTER_PROTOCOL_DNP3
    bool "DNP3 Outstation"
config ESP_TESTER_PROTOCOL_SERIAL
    bool "Serial Bridge"
config ESP_TESTER_PROTOCOL_PLC_RUNTIME
    bool "PLC Runtime"
endchoice

menu "WiFi Configuration"
    config ESP_TESTER_WIFI_SSID
        string "WiFi SSID"
        default "YOUR_WIFI"
    config ESP_TESTER_WIFI_PASSWORD
        string "WiFi Password"
        default "YOUR_PASSWORD"
endmenu

endmenu
```

## firmware/esp32-tester/sdkconfig.defaults
```kconfig
CONFIG_ESP_TESTER_WIFI_SSID="YOUR_WIFI_SSID"
CONFIG_ESP_TESTER_WIFI_PASSWORD="YOUR_WIFI_PASSWORD"
# Protocol selection (uncomment one, comment the rest)
#CONFIG_ESP_TESTER_PROTOCOL_MODBUS_SLAVE=y
#CONFIG_ESP_TESTER_PROTOCOL_MODBUS_MASTER=y
#CONFIG_ESP_TESTER_PROTOCOL_MODBUS_RTU=y
#CONFIG_ESP_TESTER_PROTOCOL_MQTT=y
CONFIG_ESP_TESTER_PROTOCOL_S7=y
#CONFIG_ESP_TESTER_PROTOCOL_ENIP=y
#CONFIG_ESP_TESTER_PROTOCOL_OPCUA=y
#CONFIG_ESP_TESTER_PROTOCOL_BACNET=y
#CONFIG_ESP_TESTER_PROTOCOL_DNP3=y
#CONFIG_ESP_TESTER_PROTOCOL_SERIAL=y
```
