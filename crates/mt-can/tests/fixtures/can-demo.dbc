VERSION "1"

NS_ :

BS_:

BU_: EDGE HOST

BO_ 256 EdgeHeartbeatVcan: 8 EDGE
 SG_ Seq : 0|32@1+ (1,0) [0|4294967295] "" HOST
 SG_ Magic : 32|32@1+ (1,0) [0|4294967295] "" HOST

BO_ 257 EdgeHeartbeat: 8 EDGE
 SG_ Seq : 0|32@1+ (1,0) [0|4294967295] "" HOST
 SG_ Magic : 32|32@1+ (1,0) [0|4294967295] "" HOST

BO_ 512 EdgeTelemetryFdVcan: 64 EDGE
 SG_ Seq : 0|32@1+ (1,0) [0|4294967295] "" HOST
 SG_ Magic : 32|32@1+ (1,0) [0|4294967295] "" HOST
 SG_ UptimeMs : 64|64@1+ (1,0) [0|0] "ms" HOST
 SG_ FramesRx : 128|64@1+ (1,0) [0|0] "" HOST
 SG_ StartCount : 192|32@1+ (1,0) [0|4294967295] "" HOST
 SG_ PatternFirst : 256|8@1+ (1,0) [0|255] "" HOST
 SG_ PatternLast : 504|8@1+ (1,0) [0|255] "" HOST

BO_ 513 EdgeTelemetryFd: 64 EDGE
 SG_ Seq : 0|32@1+ (1,0) [0|4294967295] "" HOST
 SG_ Magic : 32|32@1+ (1,0) [0|4294967295] "" HOST
 SG_ UptimeMs : 64|64@1+ (1,0) [0|0] "ms" HOST
 SG_ FramesRx : 128|64@1+ (1,0) [0|0] "" HOST
 SG_ StartCount : 192|32@1+ (1,0) [0|4294967295] "" HOST
 SG_ PatternFirst : 256|8@1+ (1,0) [0|255] "" HOST
 SG_ PatternLast : 504|8@1+ (1,0) [0|255] "" HOST

BO_ 801 HostPing: 8 HOST
 SG_ Magic : 0|32@1+ (1,0) [0|4294967295] "" EDGE
 SG_ Count : 32|32@1+ (1,0) [0|4294967295] "" EDGE

BO_ 802 HostFdPing: 64 HOST
 SG_ Magic : 0|64@1+ (1,0) [0|0] "" EDGE
 SG_ Count : 64|32@1+ (1,0) [0|4294967295] "" EDGE
 SG_ PatternFirst : 96|8@1+ (1,0) [0|255] "" EDGE
 SG_ PatternLast : 504|8@1+ (1,0) [0|255] "" EDGE

CM_ BO_ 256 "can-demo heartbeat on the guest's vcan0 (never leaves the guest)";
CM_ BO_ 257 "can-demo heartbeat on guest can0, bridged to host vcan0. Seq counts up, Magic is ASCII HBT1";
CM_ BO_ 512 "can-demo CAN FD telemetry on the guest's vcan0 (never leaves the guest)";
CM_ BO_ 513 "can-demo CAN FD telemetry on guest can0 (bit rate switch on). Magic is ASCII FDT1; bytes 32..63 count up from the low byte of Seq";
CM_ BO_ 801 "Sent by scripts/host-can.py on the host: ASCII HOST + 32-bit counter";
CM_ BO_ 802 "CAN FD frame sent by scripts/host-can.py: ASCII HOSTFD01, 32-bit counter, bytes 12..63 count up from the low byte of Count";
CM_ SG_ 257 Seq "Heartbeat sequence number, little endian";
CM_ SG_ 513 UptimeMs "Milliseconds since can-demo started";
CM_ SG_ 513 FramesRx "Frames can-demo's listener has received on this interface so far";
CM_ SG_ 513 StartCount "How often can-demo has started on this interface (kept on /data)";
BA_DEF_ BO_ "VFrameFormat" ENUM "StandardCAN","ExtendedCAN","reserved","reserved","reserved","reserved","reserved","reserved","reserved","reserved","reserved","reserved","reserved","reserved","StandardCAN_FD","ExtendedCAN_FD";
BA_DEF_ BO_ "CANFD_BRS" ENUM "0","1";
BA_DEF_DEF_ "VFrameFormat" "StandardCAN";
BA_DEF_DEF_ "CANFD_BRS" "1";
BA_ "VFrameFormat" BO_ 512 14;
BA_ "VFrameFormat" BO_ 513 14;
BA_ "VFrameFormat" BO_ 802 14;
